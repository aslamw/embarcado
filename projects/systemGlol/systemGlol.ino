#include <Adafruit_GFX.h>
#include <Adafruit_SSD1306.h>

//Define e configura display
#define OLED_RESET -1

#define BUTTON_LEFT 9
#define BUTTON_OK 10
#define BUTTON_RIGHT 11

Adafruit_SSD1306 display(OLED_RESET);

//------------------------------------------------------------------logo--------------------------------

const unsigned char logo1 [] PROGMEM = {
0x00, 0x00, 0x00, 0x03, 0x00, 0x00, 0x00, 0x00, 0x00, 0x00, 0x00, 0x00, 0x07, 0x00, 0x00, 0x00, 
0x00, 0x00, 0x00, 0x03, 0x80, 0x00, 0x00, 0x00, 0x00, 0x00, 0x00, 0x00, 0x06, 0x00, 0x00, 0x00, 
0x00, 0x00, 0x00, 0x01, 0x80, 0x00, 0x00, 0x00, 0x00, 0x00, 0x00, 0x00, 0x0c, 0x00, 0x00, 0x00, 
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0x00, 0x00, 0x00, 0x00, 0x00, 0x01, 0x80, 0x00, 0x00, 0x01, 0xc0, 0x00, 0x00, 0x00, 0x00, 0x00
};

const unsigned char logo2 [] PROGMEM = {
  0x00, 0x00, 0x00, 0x03, 0x00, 0x00, 0x00, 0x00, 0x00, 0x00, 0x00, 0x00, 0x07, 0x00, 0x00, 0x00, 
0x00, 0x00, 0x00, 0x03, 0x80, 0x00, 0x00, 0x00, 0x00, 0x00, 0x00, 0x00, 0x06, 0x00, 0x00, 0x00, 
0x00, 0x00, 0x00, 0x01, 0x80, 0x00, 0x00, 0x00, 0x00, 0x00, 0x00, 0x00, 0x0c, 0x00, 0x00, 0x00, 
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0x00, 0x00, 0x00, 0x00, 0x00, 0x01, 0x80, 0x00, 0x00, 0x01, 0xc0, 0x00, 0x00, 0x00, 0x00, 0x00
};
const unsigned char logo3 [] PROGMEM = {
  0x00, 0x00, 0x00, 0x03, 0x00, 0x00, 0x00, 0x00, 0x00, 0x00, 0x00, 0x00, 0x07, 0x00, 0x00, 0x00, 
0x00, 0x00, 0x00, 0x03, 0x80, 0x00, 0x00, 0x00, 0x00, 0x00, 0x00, 0x00, 0x06, 0x00, 0x00, 0x00, 
0x00, 0x00, 0x00, 0x01, 0x80, 0x00, 0x00, 0x00, 0x00, 0x00, 0x00, 0x00, 0x0c, 0x00, 0x00, 0x00, 
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0x00, 0x00, 0x00, 0x00, 0x00, 0x01, 0x80, 0x00, 0x00, 0x01, 0xc0, 0x00, 0x00, 0x00, 0x00, 0x00
};

//---------------------------------------------------------------------------------------------



//-------------------------------------variaveis------------------------------------------------

int time_logo = 0;

int button_left, button_ok, button_right = HIGH;
int button_index = 0;

//------------------------------------funções-----------------------------------------------------

void logo_animation (){
  //logo
  for (int8_t i = 0; i<2; i++){
    display.clearDisplay();

    display.drawBitmap(0, 0, logo1, 128, 32, WHITE);

    display.display();

    display.clearDisplay();

    display.drawBitmap(0, 0, logo2, 128, 32, WHITE);

    display.display();

    display.clearDisplay();

    display.drawBitmap(0, 0, logo3, 128, 32, WHITE);

    display.display();
  }

  display.clearDisplay();

  display.setTextColor(WHITE);
  display.setCursor(30, 12); // Posiciona o cursor
  display.println("System Glol");

  display.display();

  delay(2000);
  
}

//----------------------------------------------------------------------

void menu(){

  do{

    display.clearDisplay();

    display.setTextColor(WHITE);

    display.setCursor(30,2); // Posiciona o cursor
    display.println("Number Game");

    display.setCursor(30, 12); // Posiciona o cursor
    display.println("tic tac toe");

    display.setCursor(30, 22); // Posiciona o cursor
    display.println("spectrum");

    button_right = digitalRead(BUTTON_RIGHT);
    button_ok = digitalRead(BUTTON_OK);
    button_left = digitalRead(BUTTON_LEFT);

    switch (button_index){
      case 1:
        display.drawRect(26, 0, 75, 12, WHITE);
        break;

      case 2:
        display.drawRect(26, 10, 75, 12, WHITE);
        break;

      case 3:
        display.drawRect(26, 20, 75, 12, WHITE);
        break;
    }

    display.display();



    if (button_left == LOW){
      Serial.print("aperto esquerda");
      
      if (button_index > 0 ){
        button_index--;
      }
      else{
        button_index = 3;
      }

      delay(300);
    }

    if(button_right == LOW){
      
      Serial.print("aperto direita");
      if (button_index < 3){
        button_index++;
      }
      else{
        button_index = 1;
      }
      delay(300);
    }

    if(button_ok == LOW){
      Serial.print("aperto ok");
      button_index = 0;
      break;
    }
      
  }while(1);

}

void setup() {
  //Inicializa I2c
  Wire.begin();

  // Inicializa Display no endereço 0x3c do I2C
 
  display.begin(SSD1306_SWITCHCAPVCC, 0x3c);

  pinMode(BUTTON_LEFT,INPUT_PULLUP);
  pinMode(BUTTON_OK, INPUT_PULLUP);
  pinMode(BUTTON_RIGHT, INPUT_PULLUP);

}

void loop() {
  

  logo_animation();
  menu();



}
